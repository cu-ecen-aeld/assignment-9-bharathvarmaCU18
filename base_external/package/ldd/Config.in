## base_external/package/ldd/Config.in
```kconfig
config BR2_PACKAGE_LDD
	bool "ldd"
	help
	   This package builds misc_modules and scull sub directories.
	   This package installs the hello, scull, and faulty kernel modules from misc_modules and scull directory.
```
